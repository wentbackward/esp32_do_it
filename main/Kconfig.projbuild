## main/Kconfig.projbuild
```kconfig
menu "App: Display + Touch + LVGL Template"

config APP_VERSION
    string "Application version"
    default "V0.0"
    help
        Version string for the application.

choice APP_UI_MODE
    prompt "UI mode"
    default APP_UI_HWTEST
    help
        Select which UI starts at boot.

config APP_UI_HW_DISPLAY_TEST
    bool "Hardware Display Test (no LVGL - RGB panel validation)"
    depends on APP_HID_MODE_NONE
    help
        Tests RGB display hardware directly without LVGL.
        Shows: Red -> Green -> Blue -> Color bars.
        Use this to verify display is working before enabling LVGL.

config APP_UI_SIMPLE
    bool "Simple UI (bars + button)"
    depends on APP_HID_MODE_NONE
config APP_UI_HWTEST
    bool "Hardware test UI with LVGL"
    depends on APP_HID_MODE_NONE
config APP_UI_DEMO
    bool "LVGL demo widgets (requires LVGL demos enabled)"
    depends on APP_HID_MODE_NONE
config APP_UI_TRACKPAD
    bool "Trackpad UI (USB mouse)"
    depends on APP_HID_MODE_TRACKPAD
config APP_UI_MACROPAD
    bool "Macropad UI (USB keyboard)"
    depends on APP_HID_MODE_MACROPAD
config APP_UI_GAMEPAD
    bool "Gamepad UI (USB gamepad)"
    depends on APP_HID_MODE_GAMEPAD
endchoice

choice APP_DISPLAY_DRIVER
    prompt "Display driver"
    default APP_DISPLAY_ILI9341_SPI
    help
        Select the display backend.

config APP_DISPLAY_ILI9341_SPI
    bool "ILI9341 over SPI"

config APP_DISPLAY_RGB_PARALLEL
    bool "RGB parallel 16-bit"

config APP_DISPLAY_LGFX
    bool "LovyanGFX (supports SPI and RGB panels)"
    help
        Use LovyanGFX library as display driver. Supports multiple panel types
        with optimized performance. Configure via lgfx_user.hpp.

config APP_DISPLAY_MIPI_DSI_PLACEHOLDER
    bool "MIPI DSI (placeholder)"

endchoice

menu "Display common"
config APP_LCD_HRES
    int "Horizontal resolution"
    default 240
config APP_LCD_VRES
    int "Vertical resolution"
    default 320

config APP_LCD_COLOR_DEPTH
    int "Color depth (bits per pixel)"
    range 16 16
    default 16
    help
        Keep 16 for RGB565.

config APP_LCD_BGR
    bool "Use BGR element order"
    default y

config APP_LCD_INVERT_DEFAULT
    bool "Send invert command at init (ILI9341: 0x21)"
    default n

config APP_LCD_ROTATION_DEFAULT
    int "The default rotation of the panel"
    range 0 3
    default 0

config APP_LCD_SWAP_BYTES
    bool "Swap bytes in LVGL flush (RGB565 endianness)"
    default y

config APP_LCD_PIN_BL
    int "Backlight GPIO (-1 disable)"
    default 45

config APP_LCD_BL_PWM_ENABLE
    bool "Enable PWM backlight control"
    default n
    help
        Use LEDC PWM for adjustable brightness instead of simple on/off.

config APP_LCD_BL_PWM_FREQ_HZ
    int "Backlight PWM frequency (Hz)"
    depends on APP_LCD_BL_PWM_ENABLE
    default 5000
    range 100 40000

config APP_LCD_BL_PWM_RESOLUTION
    int "Backlight PWM resolution (bits)"
    depends on APP_LCD_BL_PWM_ENABLE
    default 10
    range 8 14

config APP_LCD_BL_DEFAULT_DUTY
    int "Default backlight duty cycle (0-100%)"
    depends on APP_LCD_BL_PWM_ENABLE
    default 80
    range 0 100
endmenu

menu "Display: LovyanGFX"
depends on APP_DISPLAY_LGFX

choice APP_LGFX_PANEL_TYPE
    prompt "LovyanGFX panel type"
    default APP_LGFX_PANEL_RGB
    help
        Select which panel type to use with LovyanGFX.

config APP_LGFX_PANEL_RGB
    bool "RGB parallel panel"

config APP_LGFX_PANEL_SPI
    bool "SPI panel (ILI9341, ST7789, etc.)"

endchoice

endmenu

menu "Display: SPI (for ILI9341)"
depends on APP_DISPLAY_ILI9341_SPI || APP_LGFX_PANEL_SPI

config APP_LCD_SPI_HOST
    int "SPI host id (2=SPI2_HOST, 3=SPI3_HOST)"
    range 2 3
    default 2

config APP_LCD_SPI_CLOCK_HZ
    int "SPI clock (Hz)"
    default 26000000

config APP_LCD_PIN_DC
    int "LCD D/C GPIO"
    default 46
config APP_LCD_PIN_CS
    int "LCD CS GPIO"
    default 10
config APP_LCD_PIN_SCK
    int "LCD SCK GPIO"
    default 12
config APP_LCD_PIN_MOSI
    int "LCD MOSI GPIO"
    default 11
config APP_LCD_PIN_MISO
    int "LCD MISO GPIO (-1 if unused)"
    default 13
config APP_LCD_PIN_RST
    int "LCD RST GPIO (-1 if tied to ESP reset)"
    default -1

endmenu


menu "Display: RGB Parallel Pins"
depends on APP_DISPLAY_RGB_PARALLEL || APP_LGFX_PANEL_RGB

config APP_LCD_RGB_PCLK_HZ
    int "RGB pixel clock (Hz)"
    default 15000000

config APP_LCD_RGB_PIN_PCLK
    int "RGB PCLK GPIO"
    default 0
config APP_LCD_RGB_PIN_HSYNC
    int "RGB HSYNC GPIO"
    default 39
config APP_LCD_RGB_PIN_VSYNC
    int "RGB VSYNC GPIO"
    default 41
config APP_LCD_RGB_PIN_DE
    int "RGB DE (Data Enable) GPIO"
    default 40

config APP_LCD_RGB_PIN_D0
    int "RGB D0 GPIO"
    default 8
config APP_LCD_RGB_PIN_D1
    int "RGB D1 GPIO"
    default 3
config APP_LCD_RGB_PIN_D2
    int "RGB D2 GPIO"
    default 46
config APP_LCD_RGB_PIN_D3
    int "RGB D3 GPIO"
    default 9
config APP_LCD_RGB_PIN_D4
    int "RGB D4 GPIO"
    default 1
config APP_LCD_RGB_PIN_D5
    int "RGB D5 GPIO"
    default 5
config APP_LCD_RGB_PIN_D6
    int "RGB D6 GPIO"
    default 6
config APP_LCD_RGB_PIN_D7
    int "RGB D7 GPIO"
    default 7
config APP_LCD_RGB_PIN_D8
    int "RGB D8 GPIO"
    default 15
config APP_LCD_RGB_PIN_D9
    int "RGB D9 GPIO"
    default 16
config APP_LCD_RGB_PIN_D10
    int "RGB D10 GPIO"
    default 4
config APP_LCD_RGB_PIN_D11
    int "RGB D11 GPIO"
    default 45
config APP_LCD_RGB_PIN_D12
    int "RGB D12 GPIO"
    default 48
config APP_LCD_RGB_PIN_D13
    int "RGB D13 GPIO"
    default 47
config APP_LCD_RGB_PIN_D14
    int "RGB D14 GPIO"
    default 21
config APP_LCD_RGB_PIN_D15
    int "RGB D15 GPIO"
    default 14

config APP_LCD_RGB_HSYNC_POLARITY
    int "HSYNC polarity (0=active low, 1=active high)"
    range 0 1
    default 0
config APP_LCD_RGB_HSYNC_FRONT_PORCH
    int "HSYNC front porch"
    default 8
config APP_LCD_RGB_HSYNC_PULSE_WIDTH
    int "HSYNC pulse width"
    default 4
config APP_LCD_RGB_HSYNC_BACK_PORCH
    int "HSYNC back porch"
    default 43

config APP_LCD_RGB_VSYNC_POLARITY
    int "VSYNC polarity (0=active low, 1=active high)"
    range 0 1
    default 0
config APP_LCD_RGB_VSYNC_FRONT_PORCH
    int "VSYNC front porch"
    default 8
config APP_LCD_RGB_VSYNC_PULSE_WIDTH
    int "VSYNC pulse width"
    default 4
config APP_LCD_RGB_VSYNC_BACK_PORCH
    int "VSYNC back porch"
    default 12

config APP_LCD_RGB_PCLK_ACTIVE_NEG
    int "PCLK active negative (0=positive edge, 1=negative edge)"
    range 0 1
    default 1
config APP_LCD_RGB_DE_IDLE_HIGH
    int "DE idle high (0=idle low, 1=idle high)"
    range 0 1
    default 0
config APP_LCD_RGB_PCLK_IDLE_HIGH
    int "PCLK idle high (0=idle low, 1=idle high)"
    range 0 1
    default 0

config APP_LCD_RGB_PIN_DISP_EN
    int "Display Enable GPIO (-1 if not used)"
    default -1
    help
        Some RGB panels have a display enable signal. Set to -1 if not used.

endmenu


choice APP_TOUCH_DRIVER
    prompt "Touch driver"
    default APP_TOUCH_FT6X36_I2C
    help
        Select touch controller backend.

config APP_TOUCH_NONE
    bool "No touch"

config APP_TOUCH_FT6X36_I2C
    bool "FT6x36/FT6336 over I2C"

config APP_TOUCH_GT911_I2C
    bool "GT911 over I2C"

endchoice

menu "Touch (I2C)"
depends on !APP_TOUCH_NONE

config APP_TOUCH_I2C_PORT
    int "I2C port (0/1)"
    range 0 1
    default 0

config APP_TOUCH_PIN_SCL
    int "Touch I2C SCL GPIO"
    default 15
config APP_TOUCH_PIN_SDA
    int "Touch I2C SDA GPIO"
    default 16

config APP_TOUCH_I2C_CLOCK_HZ
    int "Touch I2C clock (Hz)"
    default 100000

config APP_TOUCH_I2C_ADDR
    hex "Touch I2C address"
    default 0x38 if APP_TOUCH_FT6X36_I2C
    default 0x5D if APP_TOUCH_GT911_I2C
    default 0x38

config APP_TOUCH_PIN_RST
    int "Touch RST GPIO (-1 disable)"
    default 18

config APP_TOUCH_MANUAL_RESET
    bool "Manual reset pulse + boot delay (recommended for FT6x36)"
    default y if APP_TOUCH_FT6X36_I2C
    default n

config APP_TOUCH_RESET_PULSE_MS
    int "Reset low pulse (ms)"
    default 20
    depends on APP_TOUCH_MANUAL_RESET

config APP_TOUCH_RESET_BOOT_MS
    int "Boot delay after reset (ms)"
    default 250
    depends on APP_TOUCH_MANUAL_RESET

config APP_TOUCH_USE_INT_PIN
    bool "Use INT pin (optional; keep off unless proven stable)"
    default n

config APP_TOUCH_PIN_INT
    int "Touch INT GPIO"
    default 17
    depends on APP_TOUCH_USE_INT_PIN
endmenu

choice APP_HID_MODE
    prompt "HID mode"
    default APP_HID_MODE_NONE
    help
        Select USB HID device mode. ESP32-S3 uses GPIO 19/20 for USB D+/D-.

config APP_HID_MODE_NONE
    bool "No HID (display-only)"

config APP_HID_MODE_TRACKPAD
    bool "Trackpad (USB mouse)"
    help
        Touch panel acts as USB mouse. Drag to move, tap to click.

config APP_HID_MODE_MACROPAD
    bool "Macropad (USB keyboard)"
    help
        Button grid sends keyboard keys. Mappings stored in NVS.

config APP_HID_MODE_GAMEPAD
    bool "Gamepad (USB gamepad)"
    help
        D-pad and action buttons as USB gamepad.

endchoice

menu "HID: Trackpad"
depends on APP_HID_MODE_TRACKPAD

config APP_HID_TRACKPAD_SCROLL_ENABLE
    bool "Enable scroll zones"
    default y
    help
        Enables right-edge (vertical) and bottom-edge (horizontal) scroll zones.

config APP_HID_TRACKPAD_SCROLL_PERCENT
    int "Scroll zone size (%)"
    range 5 20
    default 10
    depends on APP_HID_TRACKPAD_SCROLL_ENABLE
    help
        Width/Height of the scroll zone as a percentage of the screen dimension.

config APP_HID_TRACKPAD_SCROLL_MIN_PX
    int "Scroll zone minimum size (pixels)"
    range 8 32
    default 12
    depends on APP_HID_TRACKPAD_SCROLL_ENABLE
    help
        Minimum scroll zone width/height in pixels, regardless of percentage.

config APP_HID_TRACKPAD_SCROLL_MAX_PX
    int "Scroll zone maximum size (pixels)"
    range 16 64
    default 24
    depends on APP_HID_TRACKPAD_SCROLL_ENABLE
    help
        Maximum scroll zone width/height in pixels, regardless of percentage.

config APP_HID_TRACKPAD_SENSITIVITY
    int "Sensitivity (1-10)"
    range 1 10
    default 2
    help
        Movement sensitivity multiplier. Higher = faster cursor.

config APP_HID_TRACKPAD_TAP_THRESHOLD_MS
    int "Tap threshold (ms)"
    range 50 500
    default 200
    help
        Maximum duration for tap-to-click detection.

endmenu

menu "HID: Macropad"
depends on APP_HID_MODE_MACROPAD

config APP_HID_MACROPAD_ROWS
    int "Button rows"
    range 2 4
    default 3

config APP_HID_MACROPAD_COLS
    int "Button columns"
    range 2 4
    default 4

endmenu

menu "HID: Gamepad"
depends on APP_HID_MODE_GAMEPAD

config APP_HID_GAMEPAD_BUTTON_COUNT
    int "Action buttons"
    range 2 8
    default 4
    help
        Number of action buttons (beyond D-pad). Currently supports 4 (A/B/X/Y).

endmenu

menu "LVGL port tuning"

config APP_LVGL_BUF_LINES
    int "Display buffer lines"
    range 10 120
    default 60
    help
        Buffer size = HRES * BUF_LINES pixels. 60 is a good start on S3.

config APP_LVGL_DOUBLE_BUFFER
    bool "Double buffer"
    default y

config APP_LVGL_BUFF_DMA
    bool "Use DMA-capable buffers"
    default y

config APP_ROT_SWAP_XY
    int "rotation.swap_xy (0/1)"
    range 0 1
    default 0

config APP_ROT_MIRROR_X
    int "rotation.mirror_x (0/1)"
    range 0 1
    default 1

config APP_ROT_MIRROR_Y
    int "rotation.mirror_y (0/1)"
    range 0 1
    default 0

endmenu

endmenu
```

## sdkconfig.defaults
```kconfig
# Common settings for all boards

# Application version
CONFIG_APP_VERSION="V0.3"

# Ensure the system monitor is running for development
CONFIG_LV_USE_SYSMON=n
CONFIG_LV_USE_PERF_MONITOR=n

# Slow down the kernel panic reset
CONFIG_ESP_SYSTEM_PANIC_REBOOT_DELAY_SECONDS=5

# UI refresh at 30fps, touch polling in separate task at 200Hz
CONFIG_LV_DEF_REFR_PERIOD=33
CONFIG_LV_INDEV_DEF_READ_PERIOD=10

# TinyUSB - Composite HID + CDC (Debug Console)
CONFIG_TINYUSB_CDC_ENABLED=y
CONFIG_TINYUSB_HID_COUNT=1

# Console on UART (safe default), we will redirect to CDC in app_main
CONFIG_ESP_CONSOLE_UART_DEFAULT=y
```

## sdkconfig.defaults.esp32s3_ili9341
```kconfig
# Board: ESP32-S3 + SPI ILI9341 + I2C FT6x36/FT6336
# To use: idf.py -D SDKCONFIG_DEFAULTS="sdkconfig.defaults;sdkconfig.defaults.esp32s3_ili9341" build

# Display driver selection
CONFIG_APP_DISPLAY_ILI9341_SPI=y

# Display resolution
CONFIG_APP_LCD_HRES=240
CONFIG_APP_LCD_VRES=320
CONFIG_APP_LCD_COLOR_DEPTH=16

# Display common settings
CONFIG_APP_LCD_BGR=y
CONFIG_APP_LCD_INVERT_DEFAULT=y
CONFIG_APP_LCD_SWAP_BYTES=y
CONFIG_APP_LCD_PIN_BL=45

# SPI display settings
CONFIG_APP_LCD_SPI_HOST=2
CONFIG_APP_LCD_SPI_CLOCK_HZ=26000000
CONFIG_APP_LCD_PIN_DC=46
CONFIG_APP_LCD_PIN_CS=10
CONFIG_APP_LCD_PIN_SCK=12
CONFIG_APP_LCD_PIN_MOSI=11
CONFIG_APP_LCD_PIN_MISO=13
CONFIG_APP_LCD_PIN_RST=-1

# Touch driver selection
CONFIG_APP_TOUCH_FT6X36_I2C=y

# Touch I2C settings
CONFIG_APP_TOUCH_I2C_PORT=0
CONFIG_APP_TOUCH_PIN_SCL=15
CONFIG_APP_TOUCH_PIN_SDA=16
CONFIG_APP_TOUCH_I2C_CLOCK_HZ=100000
CONFIG_APP_TOUCH_I2C_ADDR=0x38
CONFIG_APP_TOUCH_PIN_RST=18
CONFIG_APP_TOUCH_MANUAL_RESET=y
CONFIG_APP_TOUCH_RESET_PULSE_MS=20
CONFIG_APP_TOUCH_RESET_BOOT_MS=250
CONFIG_APP_TOUCH_USE_INT_PIN=n

# LVGL tuning
CONFIG_APP_LVGL_BUF_LINES=60

# Rotation
CONFIG_APP_ROT_SWAP_XY=0
CONFIG_APP_ROT_MIRROR_X=1
CONFIG_APP_ROT_MIRROR_Y=0

# ESP32-S3 CPU frequency
CONFIG_ESP_DEFAULT_CPU_FREQ_MHZ_240=y

CONFIG_APP_LVGL_DOUBLE_BUFFER=y
CONFIG_APP_LVGL_BUFF_DMA=y

# HID mode (disabled by default - uncomment to enable)
# ESP32-S3 uses GPIO 19/20 for USB D+/D- (hardware fixed)
# Note: HID modes replace standard UI modes. Only one can be active.

# Trackpad mode - Touch panel acts as USB mouse
CONFIG_APP_HID_MODE_TRACKPAD=y
CONFIG_APP_UI_TRACKPAD=y
CONFIG_APP_HID_TRACKPAD_SENSITIVITY=2
CONFIG_APP_HID_TRACKPAD_TAP_THRESHOLD_MS=200

# Macropad mode - Button grid sends keyboard keys
# CONFIG_APP_HID_MODE_MACROPAD=y
# CONFIG_APP_UI_MACROPAD=y
# CONFIG_APP_HID_MACROPAD_ROWS=3
# CONFIG_APP_HID_MACROPAD_COLS=4

# Gamepad mode - D-pad and action buttons as USB gamepad
# CONFIG_APP_HID_MODE_GAMEPAD=y
# CONFIG_APP_UI_GAMEPAD=y
# CONFIG_APP_HID_GAMEPAD_BUTTON_COUNT=4
```

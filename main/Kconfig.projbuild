## sdkconfig.defaults.esp32s3_ili9341_lgfx
```kconfig
# Board: ESP32-S3 + SPI ILI9341 + I2C FT6x36/FT6336
# To use: idf.py -D SDKCONFIG_DEFAULTS="sdkconfig.defaults;sdkconfig.defaults.esp32s3_ili9341_lgfx" build

# Display driver selection - LovyanGFX
CONFIG_APP_DISPLAY_LGFX=y
CONFIG_APP_LGFX_PANEL_SPI=y
CONFIG_IDF_TARGET="esp32s3"

# Display resolution
CONFIG_APP_LCD_HRES=240
CONFIG_APP_LCD_VRES=320
CONFIG_APP_LCD_COLOR_DEPTH=16

# Display common settings
CONFIG_APP_LCD_BGR=y
CONFIG_APP_LCD_INVERT_DEFAULT=y
CONFIG_APP_LCD_ROTATION_DEFAULT=2
CONFIG_APP_LCD_SWAP_BYTES=y
CONFIG_APP_LCD_PIN_BL=45
CONFIG_APP_LCD_BL_PWM_ENABLE=y
CONFIG_APP_LCD_BL_PWM_FREQ_HZ=5000
CONFIG_APP_LCD_BL_PWM_RESOLUTION=10
CONFIG_APP_LCD_BL_DEFAULT_DUTY=80

# SPI display settings
CONFIG_APP_LCD_SPI_HOST=2
CONFIG_APP_LCD_SPI_CLOCK_HZ=26000000
CONFIG_APP_LCD_PIN_DC=46
CONFIG_APP_LCD_PIN_CS=10
CONFIG_APP_LCD_PIN_SCK=12
CONFIG_APP_LCD_PIN_MOSI=11
CONFIG_APP_LCD_PIN_MISO=13
CONFIG_APP_LCD_PIN_RST=-1

# Touch driver selection
CONFIG_APP_TOUCH_FT6X36_I2C=y

# Touch I2C settings
CONFIG_APP_TOUCH_I2C_PORT=0
CONFIG_APP_TOUCH_PIN_SCL=15
CONFIG_APP_TOUCH_PIN_SDA=16
CONFIG_APP_TOUCH_I2C_CLOCK_HZ=400000
CONFIG_APP_TOUCH_I2C_ADDR=0x38
CONFIG_APP_TOUCH_PIN_RST=18
CONFIG_APP_TOUCH_MANUAL_RESET=y
CONFIG_APP_TOUCH_RESET_PULSE_MS=20
CONFIG_APP_TOUCH_RESET_BOOT_MS=250
CONFIG_APP_TOUCH_USE_INT_PIN=n

# LVGL tuning
CONFIG_APP_LVGL_BUF_LINES=40

# Rotation
CONFIG_APP_ROT_SWAP_XY=0
CONFIG_APP_ROT_MIRROR_X=1
CONFIG_APP_ROT_MIRROR_Y=0

# ESP32-S3 CPU frequency
CONFIG_ESP_DEFAULT_CPU_FREQ_MHZ_240=y

# ESP Tuning for performance
CONFIG_GPIO_CTRL_FUNC_IN_IRAM=y
CONFIG_I2C_ISR_IRAM_SAFE=y
CONFIG_I2S_ISR_IRAM_SAFE=y
CONFIG_LEDC_CTRL_FUNC_IN_IRAM=y
CONFIG_MCPWM_ISR_HANDLER_IN_IRAM=y
CONFIG_RMT_ENCODER_FUNC_IN_IRAM=y
CONFIG_SPI_MASTER_IN_IRAM=y
CONFIG_SPI_SLAVE_IN_IRAM=y
CONFIG_TOUCH_CTRL_FUNC_IN_IRAM=y
CONFIG_TOUCH_ISR_IRAM_SAFE=y
CONFIG_LCD_RGB_ISR_IRAM_SAFE=y
# This makes it very unstable with LGFX, keep off:
CONFIG_LCD_RGB_RESTART_IN_VSYNC=n

# PSRAM configuration for RGB panel (requires large framebuffer)
CONFIG_SPIRAM=y
CONFIG_SPIRAM_MODE_OCT=y
CONFIG_SPIRAM_SPEED_80M=y
CONFIG_SPIRAM_USE_MALLOC=y
CONFIG_SPIRAM_IGNORE_NOTFOUND=n

# LVGL memory: use C library malloc for PSRAM boards
# LovyanGFX + LVGL benefits from dynamic PSRAM allocation
CONFIG_LV_USE_CLIB_MALLOC=y
CONFIG_LV_USE_CLIB_STRING=y
CONFIG_LV_USE_CLIB_SPRINTF=y
CONFIG_LV_TXT_BREAK_CHARS=" ,.;:-_"
CONFIG_LV_USE_SNAPSHOT=y
CONFIG_APP_LVGL_BUF_LINES=40
CONFIG_LV_USE_TINY_TTF=y
CONFIG_LV_TINY_TTF_FILE_SUPPORT=n
CONFIG_LV_TINY_TTF_CACHE_GLYPH_CNT=128
CONFIG_LV_TINY_TTF_CACHE_KERNING_CNT=256
CONFIG_APP_LVGL_BUFF_DMA=y

CONFIG_APP_LVGL_DOUBLE_BUFFER=y
CONFIG_APP_LVGL_BUFF_DMA=y


# ESPTOOLPY settings
CONFIG_ESPTOOLPY_FLASHMODE_QIO=y
CONFIG_ESPTOOLPY_FLASHSIZE_4MB=y
CONFIG_FREERTOS_HZ=1000



# HID mode (disabled by default - uncomment to enable)
# ESP32-S3 uses GPIO 19/20 for USB D+/D- (hardware fixed)
# Note: HID modes replace standard UI modes. Only one can be active.

# Trackpad mode - Touch panel acts as USB mouse
CONFIG_APP_HID_MODE_TRACKPAD=y
CONFIG_APP_UI_TRACKPAD=y
CONFIG_APP_HID_TRACKPAD_SENSITIVITY=2
CONFIG_APP_HID_TRACKPAD_TAP_THRESHOLD_MS=200

# Macropad mode - Button grid sends keyboard keys
# CONFIG_APP_HID_MODE_MACROPAD=y
# CONFIG_APP_UI_MACROPAD=y
# CONFIG_APP_HID_MACROPAD_ROWS=3
# CONFIG_APP_HID_MACROPAD_COLS=4

# Gamepad mode - D-pad and action buttons as USB gamepad
# CONFIG_APP_HID_MODE_GAMEPAD=y
# CONFIG_APP_UI_GAMEPAD=y
# CONFIG_APP_HID_GAMEPAD_BUTTON_COUNT=4
```

## sdkconfig.defaults.esp32s3_lgfx_7inch
```kconfig
# Board: ELECROW CrowPanel-ESP32 7" 800x480 + RGB Panel + I2C GT911
# SKU: DIS08070H, Board Version: V3.0
# Using LovyanGFX display driver
# To use: idf.py -D SDKCONFIG_DEFAULTS="sdkconfig.defaults;sdkconfig.defaults.esp32s3_lgfx_7inch" build

# Display driver selection - LovyanGFX
CONFIG_APP_DISPLAY_LGFX=y
CONFIG_APP_LGFX_PANEL_RGB=y
CONFIG_IDF_TARGET="esp32s3"

# Display resolution
CONFIG_APP_LCD_HRES=800
CONFIG_APP_LCD_VRES=480

# Display common settings
CONFIG_APP_LCD_BGR=y
CONFIG_APP_LCD_INVERT_DEFAULT=n
CONFIG_APP_LCD_SWAP_BYTES=y

# Backlight (GPIO 2 with PWM control)
CONFIG_APP_LCD_PIN_BL=2
CONFIG_APP_LCD_BL_PWM_ENABLE=y
CONFIG_APP_LCD_BL_PWM_FREQ_HZ=5000
CONFIG_APP_LCD_BL_PWM_RESOLUTION=10
CONFIG_APP_LCD_BL_DEFAULT_DUTY=80

# RGB parallel display settings (used by lgfx_auto_config.hpp)
CONFIG_APP_LCD_RGB_PCLK_HZ=15000000
CONFIG_APP_LCD_RGB_PIN_PCLK=0
CONFIG_APP_LCD_RGB_PIN_HSYNC=39
CONFIG_APP_LCD_RGB_PIN_VSYNC=40
CONFIG_APP_LCD_RGB_PIN_DE=41

# RGB data pins (D0-D15)
CONFIG_APP_LCD_RGB_PIN_D0=15
CONFIG_APP_LCD_RGB_PIN_D1=7
CONFIG_APP_LCD_RGB_PIN_D2=6
CONFIG_APP_LCD_RGB_PIN_D3=5
CONFIG_APP_LCD_RGB_PIN_D4=4
CONFIG_APP_LCD_RGB_PIN_D5=9
CONFIG_APP_LCD_RGB_PIN_D6=46
CONFIG_APP_LCD_RGB_PIN_D7=3
CONFIG_APP_LCD_RGB_PIN_D8=8
CONFIG_APP_LCD_RGB_PIN_D9=16
CONFIG_APP_LCD_RGB_PIN_D10=1
CONFIG_APP_LCD_RGB_PIN_D11=14
CONFIG_APP_LCD_RGB_PIN_D12=21
CONFIG_APP_LCD_RGB_PIN_D13=47
CONFIG_APP_LCD_RGB_PIN_D14=48
CONFIG_APP_LCD_RGB_PIN_D15=45

# RGB timing settings
CONFIG_APP_LCD_RGB_HSYNC_POLARITY=0
CONFIG_APP_LCD_RGB_HSYNC_FRONT_PORCH=40
CONFIG_APP_LCD_RGB_HSYNC_PULSE_WIDTH=48
CONFIG_APP_LCD_RGB_HSYNC_BACK_PORCH=40
CONFIG_APP_LCD_RGB_VSYNC_POLARITY=0
CONFIG_APP_LCD_RGB_VSYNC_FRONT_PORCH=1
CONFIG_APP_LCD_RGB_VSYNC_PULSE_WIDTH=31
CONFIG_APP_LCD_RGB_VSYNC_BACK_PORCH=13
CONFIG_APP_LCD_RGB_PCLK_ACTIVE_NEG=1
CONFIG_APP_LCD_RGB_DE_IDLE_HIGH=0
CONFIG_APP_LCD_RGB_PCLK_IDLE_HIGH=0

# Touch driver selection
CONFIG_APP_TOUCH_GT911_I2C=y

# Touch I2C settings
CONFIG_APP_TOUCH_I2C_PORT=0
CONFIG_APP_TOUCH_PIN_SCL=20
CONFIG_APP_TOUCH_PIN_SDA=19
CONFIG_APP_TOUCH_I2C_CLOCK_HZ=400000
CONFIG_APP_TOUCH_I2C_ADDR=0x5D
CONFIG_APP_TOUCH_PIN_RST=-1
CONFIG_APP_TOUCH_MANUAL_RESET=n
CONFIG_APP_TOUCH_USE_INT_PIN=n

# Rotation
CONFIG_APP_ROT_SWAP_XY=0
CONFIG_APP_ROT_MIRROR_X=0
CONFIG_APP_ROT_MIRROR_Y=0

# ESP32-S3 CPU frequency
CONFIG_ESP_DEFAULT_CPU_FREQ_MHZ_240=y

# ESP Tuning for performance
CONFIG_GPIO_CTRL_FUNC_IN_IRAM=y
CONFIG_I2C_ISR_IRAM_SAFE=y
CONFIG_I2S_ISR_IRAM_SAFE=y
CONFIG_LEDC_CTRL_FUNC_IN_IRAM=y
CONFIG_MCPWM_ISR_HANDLER_IN_IRAM=y
CONFIG_RMT_ENCODER_FUNC_IN_IRAM=y
CONFIG_SPI_MASTER_IN_IRAM=y
CONFIG_SPI_SLAVE_IN_IRAM=y
CONFIG_TOUCH_CTRL_FUNC_IN_IRAM=y
CONFIG_TOUCH_ISR_IRAM_SAFE=y
CONFIG_LCD_RGB_ISR_IRAM_SAFE=y
# This makes it very unstable with LGFX, keep off:
CONFIG_LCD_RGB_RESTART_IN_VSYNC=n

# PSRAM configuration for RGB panel (requires large framebuffer)
CONFIG_SPIRAM=y
CONFIG_SPIRAM_MODE_OCT=y
CONFIG_SPIRAM_SPEED_80M=y
CONFIG_SPIRAM_USE_MALLOC=y
CONFIG_SPIRAM_IGNORE_NOTFOUND=n

# LVGL memory: use C library malloc for PSRAM boards
# LovyanGFX + LVGL benefits from dynamic PSRAM allocation
CONFIG_LV_USE_CLIB_MALLOC=y
CONFIG_LV_USE_CLIB_STRING=y
CONFIG_LV_USE_CLIB_SPRINTF=y
CONFIG_LV_TXT_BREAK_CHARS=" ,.;:-_"
CONFIG_LV_USE_SNAPSHOT=y
CONFIG_APP_LVGL_BUF_LINES=40
CONFIG_LV_USE_TINY_TTF=y
CONFIG_LV_TINY_TTF_FILE_SUPPORT=n
CONFIG_LV_TINY_TTF_CACHE_GLYPH_CNT=128
CONFIG_LV_TINY_TTF_CACHE_KERNING_CNT=256
CONFIG_APP_LVGL_BUFF_DMA=y

# ESPTOOLPY settings
CONFIG_ESPTOOLPY_FLASHMODE_QIO=y
CONFIG_ESPTOOLPY_FLASHSIZE_4MB=y
CONFIG_ESP_DEFAULT_CPU_FREQ_MHZ=240
CONFIG_FREERTOS_HZ=1000
CONFIG_PARTITION_TABLE_CUSTOM=y
```

## sdkconfig.defaults.esp32s3_rgb
```kconfig
# Board: ESP32-S3 + RGB 800x480 Panel + I2C GT911
# To use: idf.py -D SDKCONFIG_DEFAULTS="sdkconfig.defaults;sdkconfig.defaults.esp32s3_rgb" build

# Display driver selection
CONFIG_APP_DISPLAY_RGB_PARALLEL=y
CONFIG_IDF_TARGET="esp32s3"

# Display resolution
CONFIG_APP_LCD_HRES=800
CONFIG_APP_LCD_VRES=480
CONFIG_APP_LCD_COLOR_DEPTH=16

# Display common settings
CONFIG_APP_LCD_BGR=y
CONFIG_APP_LCD_INVERT_DEFAULT=n
CONFIG_APP_LCD_SWAP_BYTES=n

# Backlight (Elecrow V3.0 uses GPIO 2 for TFT_BL)
CONFIG_APP_LCD_PIN_BL=2
CONFIG_APP_LCD_BL_PWM_ENABLE=y
CONFIG_APP_LCD_BL_PWM_FREQ_HZ=5000
CONFIG_APP_LCD_BL_PWM_RESOLUTION=10
CONFIG_APP_LCD_BL_DEFAULT_DUTY=80

# RGB parallel display settings
CONFIG_APP_LCD_RGB_PCLK_HZ=15000000
CONFIG_APP_LCD_RGB_PIN_PCLK=0
CONFIG_APP_LCD_RGB_PIN_HSYNC=39
CONFIG_APP_LCD_RGB_PIN_VSYNC=41
CONFIG_APP_LCD_RGB_PIN_DE=40
CONFIG_APP_LCD_RGB_PIN_D0=8
CONFIG_APP_LCD_RGB_PIN_D1=3
CONFIG_APP_LCD_RGB_PIN_D2=46
CONFIG_APP_LCD_RGB_PIN_D3=9
CONFIG_APP_LCD_RGB_PIN_D4=1
CONFIG_APP_LCD_RGB_PIN_D5=5
CONFIG_APP_LCD_RGB_PIN_D6=6
CONFIG_APP_LCD_RGB_PIN_D7=7
CONFIG_APP_LCD_RGB_PIN_D8=15
CONFIG_APP_LCD_RGB_PIN_D9=16
CONFIG_APP_LCD_RGB_PIN_D10=4
CONFIG_APP_LCD_RGB_PIN_D11=45
CONFIG_APP_LCD_RGB_PIN_D12=48
CONFIG_APP_LCD_RGB_PIN_D13=47
CONFIG_APP_LCD_RGB_PIN_D14=21
CONFIG_APP_LCD_RGB_PIN_D15=14

# RGB timing settings
CONFIG_APP_LCD_RGB_HSYNC_POLARITY=0
CONFIG_APP_LCD_RGB_HSYNC_FRONT_PORCH=8
CONFIG_APP_LCD_RGB_HSYNC_PULSE_WIDTH=4
CONFIG_APP_LCD_RGB_HSYNC_BACK_PORCH=43
CONFIG_APP_LCD_RGB_VSYNC_POLARITY=0
CONFIG_APP_LCD_RGB_VSYNC_FRONT_PORCH=8
CONFIG_APP_LCD_RGB_VSYNC_PULSE_WIDTH=4
CONFIG_APP_LCD_RGB_VSYNC_BACK_PORCH=12
CONFIG_APP_LCD_RGB_PCLK_ACTIVE_NEG=1
CONFIG_APP_LCD_RGB_DE_IDLE_HIGH=0
CONFIG_APP_LCD_RGB_PCLK_IDLE_HIGH=0

# Touch driver selection
CONFIG_APP_TOUCH_GT911_I2C=y

# Touch I2C settings
CONFIG_APP_TOUCH_I2C_PORT=0
CONFIG_APP_TOUCH_PIN_SCL=20
CONFIG_APP_TOUCH_PIN_SDA=19
CONFIG_APP_TOUCH_I2C_CLOCK_HZ=400000
CONFIG_APP_TOUCH_I2C_ADDR=0x5D
CONFIG_APP_TOUCH_PIN_RST=-1
CONFIG_APP_TOUCH_MANUAL_RESET=n
CONFIG_APP_TOUCH_USE_INT_PIN=n

# Rotation
CONFIG_APP_ROT_SWAP_XY=0
CONFIG_APP_ROT_MIRROR_X=0
CONFIG_APP_ROT_MIRROR_Y=0

# ESP32-S3 CPU frequency
CONFIG_ESP_DEFAULT_CPU_FREQ_MHZ_240=y

# PSRAM configuration for RGB panel (requires large framebuffer)
CONFIG_SPIRAM=y
CONFIG_SPIRAM_MODE_OCT=y
CONFIG_SPIRAM_SPEED_80M=y
CONFIG_SPIRAM_USE_CAPS_ALLOC=y
CONFIG_SPIRAM_IGNORE_NOTFOUND=n

# LVGL memory: use C library malloc for PSRAM boards
# This allows LVGL to dynamically use all available PSRAM (~8 MB) instead of a fixed 128 KB pool.
# ESP-IDF's malloc automatically places large allocations (>16 KB) in PSRAM and
# small/critical allocations in internal RAM (CONFIG_SPIRAM_MALLOC_ALWAYSINTERNAL=16384).
# No need to tune LV_MEM_SIZE - LVGL uses as much memory as needed from available PSRAM.
CONFIG_LV_USE_CLIB_MALLOC=y
CONFIG_LV_TXT_BREAK_CHARS=" ,.;:-_"                                                   
CONFIG_LV_USE_SNAPSHOT=y
CONFIG_APP_LVGL_BUF_LINES=40

# ESPTOOLPY settings
CONFIG_ESPTOOLPY_FLASHMODE_QIO=y
CONFIG_ESPTOOLPY_FLASHSIZE_4MB=y
CONFIG_ESP_DEFAULT_CPU_FREQ_MHZ_240=y
CONFIG_FREERTOS_HZ=1000
CONFIG_PARTITION_TABLE_CUSTOM=y
CONFIG_ESP_SYSTEM_PANIC_REBOOT_DELAY_SECONDS=5

# HID mode (disabled by default - uncomment to enable)
# WARNING: ESP32-S3 USB uses GPIO 19/20 for D+/D-. This board uses GPIO 19/20 for touch I2C.
# To use HID mode, you must reconfigure touch I2C to different pins or disable touch.
# Note: HID modes replace standard UI modes. Only one can be active.

# Trackpad mode - Touch panel acts as USB mouse
# CONFIG_APP_HID_MODE_TRACKPAD=y
# CONFIG_APP_UI_TRACKPAD=y
# CONFIG_APP_HID_TRACKPAD_SENSITIVITY=2
# CONFIG_APP_HID_TRACKPAD_TAP_THRESHOLD_MS=200

# Macropad mode - Button grid sends keyboard keys
# CONFIG_APP_HID_MODE_MACROPAD=y
# CONFIG_APP_UI_MACROPAD=y
# CONFIG_APP_HID_MACROPAD_ROWS=3
# CONFIG_APP_HID_MACROPAD_COLS=4

# Gamepad mode - D-pad and action buttons as USB gamepad
# CONFIG_APP_HID_MODE_GAMEPAD=y
# CONFIG_APP_UI_GAMEPAD=y
# CONFIG_APP_HID_GAMEPAD_BUTTON_COUNT=4
```

## sdkconfig.defaults.esp32s3_rgb_7inch
```kconfig
# Board: ELECROW CrowPanel-ESP32 7" 800x480 + RGB Panel + I2C GT911
# SKU: DIS08070H, Board Version: V3.0
# To use: idf.py -D SDKCONFIG_DEFAULTS="sdkconfig.defaults;sdkconfig.defaults.esp32s3_rgb_7inch" build

# Display driver selection
CONFIG_APP_DISPLAY_RGB_PARALLEL=y
CONFIG_IDF_TARGET="esp32s3"

# Display resolution
CONFIG_APP_LCD_HRES=800
CONFIG_APP_LCD_VRES=480
CONFIG_APP_LCD_COLOR_DEPTH=16

# Display common settings
CONFIG_APP_LCD_BGR=y
CONFIG_APP_LCD_INVERT_DEFAULT=n
CONFIG_APP_LCD_SWAP_BYTES=n

# Backlight (assumes GPIO 2 like other Elecrow V3.0 boards)
CONFIG_APP_LCD_PIN_BL=2
CONFIG_APP_LCD_BL_PWM_ENABLE=y
CONFIG_APP_LCD_BL_PWM_FREQ_HZ=5000
CONFIG_APP_LCD_BL_PWM_RESOLUTION=10
CONFIG_APP_LCD_BL_DEFAULT_DUTY=80

# RGB parallel display settings
# Pin mapping from gfx_conf.h (LovyanGFX format)
CONFIG_APP_LCD_RGB_PCLK_HZ=15000000
CONFIG_APP_LCD_RGB_PIN_PCLK=0
CONFIG_APP_LCD_RGB_PIN_HSYNC=39
CONFIG_APP_LCD_RGB_PIN_VSYNC=40
CONFIG_APP_LCD_RGB_PIN_DE=41

# RGB data pins (D0-D15 mapped from gfx_conf.h lines 64-81)
# D0 (B0) = GPIO 15
CONFIG_APP_LCD_RGB_PIN_D0=15
# D1 (B1) = GPIO 7
CONFIG_APP_LCD_RGB_PIN_D1=7
# D2 (B2) = GPIO 6
CONFIG_APP_LCD_RGB_PIN_D2=6
# D3 (B3) = GPIO 5
CONFIG_APP_LCD_RGB_PIN_D3=5
# D4 (B4) = GPIO 4
CONFIG_APP_LCD_RGB_PIN_D4=4
# D5 (G0) = GPIO 9
CONFIG_APP_LCD_RGB_PIN_D5=9
# D6 (G1) = GPIO 46
CONFIG_APP_LCD_RGB_PIN_D6=46
# D7 (G2) = GPIO 3
CONFIG_APP_LCD_RGB_PIN_D7=3
# D8 (G3) = GPIO 8
CONFIG_APP_LCD_RGB_PIN_D8=8
# D9 (G4) = GPIO 16
CONFIG_APP_LCD_RGB_PIN_D9=16
# D10 (G5) = GPIO 1
CONFIG_APP_LCD_RGB_PIN_D10=1
# D11 (R0) = GPIO 14
CONFIG_APP_LCD_RGB_PIN_D11=14
# D12 (R1) = GPIO 21
CONFIG_APP_LCD_RGB_PIN_D12=21
# D13 (R2) = GPIO 47
CONFIG_APP_LCD_RGB_PIN_D13=47
# D14 (R3) = GPIO 48
CONFIG_APP_LCD_RGB_PIN_D14=48
# D15 (R4) = GPIO 45
CONFIG_APP_LCD_RGB_PIN_D15=45

# RGB timing settings 
CONFIG_APP_LCD_RGB_HSYNC_POLARITY=0
CONFIG_APP_LCD_RGB_HSYNC_FRONT_PORCH=40
CONFIG_APP_LCD_RGB_HSYNC_PULSE_WIDTH=48
CONFIG_APP_LCD_RGB_HSYNC_BACK_PORCH=40
CONFIG_APP_LCD_RGB_VSYNC_POLARITY=0
CONFIG_APP_LCD_RGB_VSYNC_FRONT_PORCH=1
CONFIG_APP_LCD_RGB_VSYNC_PULSE_WIDTH=31
CONFIG_APP_LCD_RGB_VSYNC_BACK_PORCH=13
CONFIG_APP_LCD_RGB_PCLK_ACTIVE_NEG=1
CONFIG_APP_LCD_RGB_DE_IDLE_HIGH=0
CONFIG_APP_LCD_RGB_PCLK_IDLE_HIGH=0

# Touch driver selection
CONFIG_APP_TOUCH_GT911_I2C=y

# Touch I2C settings (from gfx_conf.h lines 15-18)
CONFIG_APP_TOUCH_I2C_PORT=0
CONFIG_APP_TOUCH_PIN_SCL=20
CONFIG_APP_TOUCH_PIN_SDA=19
CONFIG_APP_TOUCH_I2C_CLOCK_HZ=400000
CONFIG_APP_TOUCH_I2C_ADDR=0x5D
CONFIG_APP_TOUCH_PIN_RST=-1
CONFIG_APP_TOUCH_MANUAL_RESET=n
CONFIG_APP_TOUCH_USE_INT_PIN=n

# Rotation
CONFIG_APP_ROT_SWAP_XY=0
CONFIG_APP_ROT_MIRROR_X=0
CONFIG_APP_ROT_MIRROR_Y=0

# ESP32-S3 CPU frequency
CONFIG_ESP_DEFAULT_CPU_FREQ_MHZ_240=y

# ESP Tuning
CONFIG_GPIO_CTRL_FUNC_IN_IRAM=y
CONFIG_I2C_ISR_IRAM_SAFE=y
CONFIG_I2S_ISR_IRAM_SAFE=y
CONFIG_LEDC_CTRL_FUNC_IN_IRAM=y
CONFIG_MCPWM_ISR_HANDLER_IN_IRAM=y
CONFIG_RMT_ENCODER_FUNC_IN_IRAM=y
CONFIG_SPI_MASTER_IN_IRAM=y
CONFIG_SPI_SLAVE_IN_IRAM=y
CONFIG_TOUCH_CTRL_FUNC_IN_IRAM=y
CONFIG_TOUCH_ISR_IRAM_SAFE=y
CONFIG_LCD_RGB_ISR_IRAM_SAFE=y 
# This makes it very unstable, keep off:
CONFIG_LCD_RGB_RESTART_IN_VSYNC=n

# PSRAM configuration for RGB panel (requires large framebuffer)
CONFIG_SPIRAM=y
CONFIG_SPIRAM_MODE_OCT=y
CONFIG_SPIRAM_SPEED_80M=y
CONFIG_SPIRAM_IGNORE_NOTFOUND=n
CONFIG_SPIRAM_USE_MALLOC=y

# LVGL memory: use C library malloc for PSRAM boards
# This allows LVGL to dynamically use all available PSRAM (~8 MB) instead of a fixed 128 KB pool.
# ESP-IDF's malloc automatically places large allocations (>16 KB) in PSRAM and
# small/critical allocations in internal RAM (CONFIG_SPIRAM_MALLOC_ALWAYSINTERNAL=16384).
# No need to tune LV_MEM_SIZE - LVGL uses as much memory as needed from available PSRAM.
CONFIG_LV_USE_CLIB_MALLOC=y
CONFIG_LV_USE_CLIB_STRING=y
CONFIG_LV_USE_CLIB_SPRINTF=y
CONFIG_LV_TXT_BREAK_CHARS=" ,.;:-_"
CONFIG_LV_USE_SNAPSHOT=y
CONFIG_APP_LVGL_BUF_LINES=40
CONFIG_LV_USE_TINY_TTF=y
CONFIG_LV_TINY_TTF_FILE_SUPPORT=n
CONFIG_LV_TINY_TTF_CACHE_GLYPH_CNT=128
CONFIG_LV_TINY_TTF_CACHE_KERNING_CNT=256
CONFIG_APP_LVGL_BUFF_DMA=y

# ESPTOOLPY settings
CONFIG_ESPTOOLPY_FLASHMODE_QIO=y
CONFIG_ESPTOOLPY_FLASHSIZE_4MB=y
CONFIG_ESP_DEFAULT_CPU_FREQ_MHZ_240=y
CONFIG_FREERTOS_HZ=1000
CONFIG_PARTITION_TABLE_CUSTOM=y
```
